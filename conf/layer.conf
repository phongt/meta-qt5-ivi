## conf/layer.conf
```bitbake
# We have a conf and classes directory, add to BBPATH
BBPATH .= ":${LAYERDIR}"

# We have recipes-* directories, add to BBFILES
BBFILES += "${LAYERDIR}/recipes-*/*/*.bb \
	${LAYERDIR}/recipes-*/*/*.bbappend"

BBFILE_COLLECTIONS += "qt5-ivi"
BBFILE_PATTERN_qt5-ivi = "^${LAYERDIR}/"
BBFILE_PRIORITY_qt5-ivi = "7"

LICENSE_PATH += "${LAYERDIR}/files/licenses"
```
